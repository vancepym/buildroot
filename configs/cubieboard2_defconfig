## configs/cubieboard2_defconfig
```kconfig
BR2_arm=y
BR2_cortex_a7=y
BR2_KERNEL_HEADERS_3_4=y
BR2_TOOLCHAIN_BUILDROOT_LOCALE=y
BR2_TOOLCHAIN_BUILDROOT_CXX=y
BR2_TARGET_GENERIC_HOSTNAME="Cubieboard2"
BR2_TARGET_GENERIC_ISSUE="Welcome to use Cubieboard!"
BR2_ROOTFS_DEVICE_CREATION_DYNAMIC_EUDEV=y
BR2_SYSTEM_BIN_SH_BASH=y
BR2_TARGET_GENERIC_GETTY_PORT="ttyS0"
BR2_TARGET_TZ_INFO=y
BR2_TARGET_LOCALTIME="Asia/Shanghai"
BR2_ROOTFS_POST_IMAGE_SCRIPT="board/cubietech/cubieboard/post-image.sh"
BR2_LINUX_KERNEL=y
BR2_LINUX_KERNEL_CUSTOM_GIT=y
BR2_LINUX_KERNEL_CUSTOM_REPO_URL="https://github.com/linux-sunxi/linux-sunxi.git"
BR2_LINUX_KERNEL_CUSTOM_REPO_VERSION="d47d367036be38c5180632ec8a3ad169a4593a88"
BR2_LINUX_KERNEL_PATCH="board/cubietech/cubieboard/5e953778a2aab04929a5e7b69f53dc26e39b079e.patch"
BR2_LINUX_KERNEL_DEFCONFIG="sun7i"
BR2_LINUX_KERNEL_CONFIG_FRAGMENT_FILES="board/cubietech/cubieboard/sun7i-cubieboard2.config"
BR2_PACKAGE_BUSYBOX_SHOW_OTHERS=y
BR2_PACKAGE_SUNXI_TOOLS=y
BR2_PACKAGE_LIBERATION=y
BR2_PACKAGE_FREERDP=y
BR2_PACKAGE_XORG7=y
BR2_PACKAGE_XSERVER_XORG_SERVER=y
BR2_PACKAGE_XSERVER_XORG_SERVER_MODULAR=y
BR2_PACKAGE_XDRIVER_XF86_INPUT_EVDEV=y
BR2_PACKAGE_XDRIVER_XF86_INPUT_KEYBOARD=y
BR2_PACKAGE_XDRIVER_XF86_INPUT_MOUSE=y
BR2_PACKAGE_XDRIVER_XF86_VIDEO_FBTURBO=y
BR2_PACKAGE_SUNXI_BOARDS=y
BR2_PACKAGE_SUNXI_BOARDS_FEX_FILE="a20/cubieboard2.fex"
BR2_PACKAGE_NTP=y
BR2_TARGET_UBOOT=y
BR2_TARGET_UBOOT_BOARDNAME="Cubieboard2"
BR2_TARGET_UBOOT_SPL=y
BR2_TARGET_UBOOT_SPL_NAME="u-boot-sunxi-with-spl.bin"
BR2_PACKAGE_HOST_UBOOT_TOOLS=y
```

## configs/cubieboard_defconfig
```kconfig
BR2_arm=y
BR2_cortex_a8=y
BR2_TOOLCHAIN_EXTERNAL=y
BR2_TARGET_ROOTFS_EXT2=y
BR2_TARGET_ROOTFS_EXT2_GZIP=y
BR2_TARGET_ROOTFS_TAR_GZIP=y
BR2_TARGET_UBOOT=y
BR2_TARGET_UBOOT_BOARDNAME="cubieboard"
BR2_TARGET_UBOOT_CUSTOM_GIT=y
BR2_TARGET_UBOOT_CUSTOM_GIT_REPO_URL="https://github.com/linux-sunxi/u-boot-sunxi.git"
BR2_TARGET_UBOOT_CUSTOM_GIT_VERSION="fc40799"
BR2_TARGET_UBOOT_SPL=y
BR2_TARGET_UBOOT_SPL_NAME="spl/sunxi-spl.bin"
BR2_LINUX_KERNEL=y
BR2_LINUX_KERNEL_CUSTOM_GIT=y
BR2_LINUX_KERNEL_CUSTOM_GIT_REPO_URL="https://github.com/linux-sunxi/linux-sunxi.git"
BR2_LINUX_KERNEL_CUSTOM_GIT_VERSION="sunxi-3.0"
BR2_LINUX_KERNEL_DEFCONFIG="sun4i"
```

## configs/mele_a1000_defconfig
```kconfig
BR2_arm=y
BR2_cortex_a8=y
BR2_KERNEL_HEADERS_3_4=y
BR2_TARGET_GENERIC_HOSTNAME="Mele-A1000"
BR2_TARGET_GENERIC_ISSUE="Welcome to use Mele-A1000!"
BR2_TARGET_GENERIC_GETTY_PORT="ttyS0"
BR2_ROOTFS_POST_IMAGE_SCRIPT="board/cubietech/cubieboard/post-image.sh"
BR2_LINUX_KERNEL=y
BR2_LINUX_KERNEL_CUSTOM_GIT=y
BR2_LINUX_KERNEL_CUSTOM_REPO_URL="https://github.com/linux-sunxi/linux-sunxi.git"
BR2_LINUX_KERNEL_CUSTOM_REPO_VERSION="d47d367036be38c5180632ec8a3ad169a4593a88"
BR2_LINUX_KERNEL_PATCH="board/cubietech/cubieboard/5e953778a2aab04929a5e7b69f53dc26e39b079e.patch"
BR2_LINUX_KERNEL_DEFCONFIG="sun4i"
BR2_LINUX_KERNEL_CONFIG_FRAGMENT_FILES="board/cubietech/cubieboard/sun4i-mele_a1000.config"
BR2_PACKAGE_SUNXI_TOOLS=y
BR2_PACKAGE_SUNXI_BOARDS=y
BR2_PACKAGE_SUNXI_BOARDS_FEX_FILE="a10/mele_a1000.fex"
BR2_TARGET_UBOOT=y
BR2_TARGET_UBOOT_BOARDNAME="Mele_A1000"
BR2_TARGET_UBOOT_SPL=y
BR2_TARGET_UBOOT_SPL_NAME="u-boot-sunxi-with-spl.bin"
BR2_PACKAGE_HOST_UBOOT_TOOLS=y
```

## package/remmina/Config.in
```kconfig
config BR2_PACKAGE_REMMINA
	bool "remmina"
	depends on BR2_PACKAGE_LIBGTK3
	depends on BR2_USE_MMU # libvncserver depends on BR2_USE_MMU
	depends on BR2_USE_WCHAR # freerdp
	depends on !BR2_STATIC_LIBS # freerdp
	depends on BR2_TOOLCHAIN_HAS_THREADS # freerdp
	select BR2_PACKAGE_LIBGCRYPT
	select BR2_PACKAGE_LIBSSH
	select BR2_PACKAGE_LIBVNCSERVER
	select BR2_PACKAGE_FREERDP
	select BR2_PACKAGE_GETTEXT if BR2_NEEDS_GETTEXT_IF_LOCALE
	help
	  Remmina is a remote desktop client written in GTK+, aiming to be
	  useful for system administrators and travellers, who need to work
	  with lots of remote computers in front of either large monitors
	  or tiny netbooks.

	  Remmina supports multiple network protocols in an integrated and
	  consistent user interface.

	  Currently RDP, VNC, NX, XDMCP and SSH are supported.

	  http://remmina.sourceforge.net/
```

## package/vlmcsd/Config.in
```kconfig
config BR2_PACKAGE_VLMCSD
	bool "vlmcsd"
	help
	  KMS Emulator in C (currently runs on Linux including Android,
	  FreeBSD, Solaris, Minix, Mac OS, iOS, Windows with or without
	  Cygwin).

	  http://forums.mydigitallife.info/threads/50234
```

## package/x11r7/xdriver_xf86-video-fbturbo/Config.in
```kconfig
config BR2_PACKAGE_XDRIVER_XF86_VIDEO_FBTURBO
	bool "xf86-video-fbturbo"
	select BR2_PACKAGE_LIBDRI2
	select BR2_PACKAGE_XPROTO_FONTSPROTO
	select BR2_PACKAGE_XPROTO_RANDRPROTO
	select BR2_PACKAGE_XPROTO_RENDERPROTO
	select BR2_PACKAGE_XPROTO_VIDEOPROTO
	select BR2_PACKAGE_XPROTO_XPROTO
	select BR2_PACKAGE_XPROTO_XF86DRIPROTO
	help
	  video driver, primarily optimized for the devices powered
	  by the Allwinner SoC (A10, A13, A20). It can use some of
	  the 2D/3D hardware acceleration features.

	  And because this driver is based on xf86-video-fbdev (with none of the
	  original features stripped), it actually supports all the same hardware
	  as xf86-video-fbdev. Essentially, xf86-video-fbturbo can be just used as
	  a drop-in replacement and run on practically any Linux system. There will
	  be no real difference on x86, but any ARM based system should see better
	  performance thanks to some additional optimizations (the elimination of
	  ShadowFB layer, ARM NEON/VFP code for dealing with uncached framebuffer
	  reads, automatic backing store management for faster window moves).

	  == 2D graphics acceleration features ==

	  Hardware accelerated window moving/scrolling on Allwinner A10/A20 (using the
	  G2D Mixer Processor).

	  Hardware accelerated window moving/scrolling on Raspberry Pi (using the BCM2835
	  DMA Controller)

	  == 3D graphics acceleration features ==

	  First a disclaimer to prevent any possible misunderstanding. The Xorg DDX
	  drivers (neither this one, nor the others) do not do any actual 3D acceleration
	  by themselves. They are nothing else but just a glue between the 3D drivers
	  and the X11 window system. Still a poorly implemented glue can easily become
	  the source of major performance problems. So it's important to do it right.

	  This DDX driver provides integration for Mali 400 GPU into Xorg. Any device
	  with Mali 400 should have a properly working OpenGL ES 2.0 acceleration if
	  it has Mali/UMP modules in the Linux kernel and libMali.so proprietary
	  binary blob installed in the system. Additionally, the hardware overlay
	  feature of Allwinner A10/A13/A20 display controller allows to support
	  zero-copy OpenGL ES buffer flipping without tearing. The rest of the
	  devices with Mali 400 hardware (Exynos4, Rockchip, ...) are expected to
	  have roughly the same 3D performance as when using the reference vendor
	  provided Xorg DDX driver xf86-video-mali.

	  == Video acceleration features ==

	  XV overlay is supported on Allwinner A10/A13/A20.

	  == Installation instructions ==

	  https://github.com/ssvb/xf86-video-fbturbo/wiki/Installation
```
